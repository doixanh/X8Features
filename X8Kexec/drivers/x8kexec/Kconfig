## X8Kexec/drivers/x8kexec/Kconfig
```kconfig
#
# X8OC module configuration
#

config X8_KEXEC
	tristate "X8 kexec"
	help
	  Say Y here if you want to build a module to fix kexec for X8

	  If unsure, say N.

	  To compile this module, choose M here: the
	  module will be called x8kexec.
```

## X8MDDI/drivers/x8mddi/Kconfig
```kconfig
#
# X8OC module configuration
#

config X8_MDDI
	tristate "X8 mddi"
	help
	  Say Y here if you want to build a module to fix mddi lags for X8

	  If unsure, say N.

	  To compile this module, choose M here: the
	  module will be called x8mddi.
```

## X8Overclock/drivers/oc/Kconfig
```kconfig
#
# X8OC module configuration
#

config X8_OVERCLOCK
	tristate "X8 overclock"
	help
	  Say Y here if you want to build an overclock module for X8

	  If unsure, say N.

	  To compile this module, choose M here: the
	  module will be called x8oc.
```

## X8Undervolt/drivers/uv/Kconfig
```kconfig
#
# X8OC module configuration
#

config X8_UNDERVOLT
	tristate "X8 undervolt"
	help
	  Say Y here if you want to build an undervolt module for X8

	  If unsure, say N.

	  To compile this module, choose M here: the
	  module will be called x8uv.
```
